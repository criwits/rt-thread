## bsp/pgl22g/Kconfig
```kconfig
mainmenu "RT-Thread Project Configuration"

config BSP_DIR
    string
    option env="BSP_ROOT"
    default "."

config RTT_DIR
    string
    option env="RTT_ROOT"
    default "../../"

config PKGS_DIR
    string
    option env="PKGS_ROOT"
    default "packages"

source "$RTT_DIR/Kconfig"
source "$PKGS_DIR/Kconfig"

config BOARD_pgl22g
     bool
     select ARCH_RISCV
     select RT_USING_COMPONENTS_INIT
     select RT_USING_USER_MAIN
     default y

config RT_USING_USERSPACE
    bool
    default y

source "driver/Kconfig"

config __START_ADDR__
    hex "start address"
    default 0x80000000

config __STACK_ADDR__
    hex "stack address, usually where RAM starts"
    default 0x88000000

config __STACKSIZE__
    int "stack size for interrupt"
    default 4096

config HEAP_SIZE
    int "heap size (byte)"
    default 67108864

menu "Coremark Config"

config COREMARK_ITERATIONS
    int "Iterations number for Coremark"
    default 0

choice
    prompt "Running Mode"
    default COREMARK_PERFORMANCE
config COREMARK_PROFILE
    bool "Profile Run"
config COREMARK_PERFORMANCE
    bool "Performance Run"
config COREMARK_VALIDATION
    bool "Validation Run"
endchoice

endmenu
```
